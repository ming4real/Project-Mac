## layers/my-layers/meta-mac/conf/machine/macbookpro14-3.conf
```bitbake
#@TYPE: Machine
#@NAME: Apple MacBook Pro 15-inch (2017)
#@DESCRIPTION: Apple MacBookPro14,3, Intel Kaby Lake

require conf/machine/genericx86-64.conf

PREFERRED_PROVIDER_virtual/kernel = "linux-stable"
PREFERRED_VERSION_linux-stable = "6.18%"
KBUILD_DEFCONFIG = "x86_64_defconfig"

WKS_FILE = "macbookpro.wks.in"
```

## layers/project/meta-mac-distro/conf/distro/mac-distro.conf
```bitbake
DISTRO = "mac-distro"
DISTRO_NAME = "Mac Linux (Yocto Project)"
DISTRO_VERSION = "0.1.0"
PACKAGE_CLASSES = "package_ipk"

DISTRO_FEATURES:append = " pam"
DISTRO_FEATURES:append = " systemd"
DISTRO_FEATURES:remove = "sysvinit"

# Needed for flatpak
DISTRO_FEATURES:append = " polkit"

VIRTUAL-RUNTIME_init_manager = "systemd"
VIRTUAL-RUNTIME_initscripts = ""
```
